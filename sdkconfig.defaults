## sdkconfig.defaults
```kconfig
CONFIG_IDF_TARGET="esp32s3"
CONFIG_IDF_TARGET_ESP32S3=y


##
## Security features
##
#CONFIG_SECURE_SIGNED_ON_BOOT=y
#CONFIG_SECURE_SIGNED_ON_UPDATE=y
#CONFIG_SECURE_SIGNED_APPS=y
#CONFIG_SECURE_BOOT_V2_RSA_SUPPORTED=y
#CONFIG_SECURE_BOOT_V2_PREFERRED=y
#CONFIG_SECURE_BOOT_V2_RSA_ENABLED=y
#CONFIG_SECURE_SIGNED_APPS_RSA_SCHEME=y
#CONFIG_SECURE_BOOT=y
#CONFIG_SECURE_BOOT_V2_ENABLED=y
#CONFIG_SECURE_BOOT_BUILD_SIGNED_BINARIES=y
#CONFIG_SECURE_BOOT_SIGNING_KEY="secure_boot_signing_key.pem"
#CONFIG_SECURE_FLASH_ENC_ENABLED=y
#CONFIG_SECURE_FLASH_ENCRYPTION_AES128=y
#CONFIG_SECURE_FLASH_ENCRYPTION_MODE_DEVELOPMENT=y
#CONFIG_SECURE_FLASH_HAS_WRITE_PROTECTION_CACHE=y
#
##
## Potentially insecure options
##
## CONFIG_SECURE_BOOT_ALLOW_JTAG is not set
#CONFIG_SECURE_FLASH_UART_BOOTLOADER_ALLOW_ENC=y
#CONFIG_SECURE_FLASH_SKIP_WRITE_PROTECTION_CACHE=y
## end of Potentially insecure options
#
#CONFIG_SECURE_FLASH_ENCRYPT_ONLY_IMAGE_LEN_IN_APP_PART=y
#CONFIG_SECURE_FLASH_CHECK_ENC_EN_IN_APP=y
#CONFIG_SECURE_INSECURE_ALLOW_DL_MODE=y
## end of Security features
#
#CONFIG_FLASH_ENCRYPTION_ENABLED=y
#CONFIG_FLASH_ENCRYPTION_INSECURE=y
#CONFIG_FLASH_ENCRYPTION_UART_BOOTLOADER_ALLOW_ENCRYPT=y





#
# ESP System Settings
#
CONFIG_ESP_DEFAULT_CPU_FREQ_MHZ_240=y
CONFIG_ESP_MAIN_TASK_STACK_SIZE=8192
CONFIG_ESPTOOLPY_FLASHSIZE_8MB=y
CONFIG_ESPTOOLPY_FLASHSIZE="8MB"

#
# FreeRTOS
#

#
# Kernel
#
CONFIG_FREERTOS_HZ=1000

#
# Compiler options
#
CONFIG_COMPILER_OPTIMIZATION_PERF=y

#
# ESP PSRAM
#
CONFIG_SPIRAM=y
CONFIG_SPIRAM_MODE_OCT=y
CONFIG_SPIRAM_SPEED_80M=y
CONFIG_ESP32S3_DATA_CACHE_LINE_64B=y

#
# Partition Table
#
CONFIG_PARTITION_TABLE_CUSTOM=y
CONFIG_PARTITION_TABLE_CUSTOM_FILENAME="partitions.csv"
 

#
# LVGL configuration
#
CONFIG_LV_CONF_SKIP=n
CONFIG_LV_USE_QRCODE=y
 
```
